; Script to create a ROM image for the ITER-8.
; Counts and displays on the LCD the number of interrupts generated by a push button.
;
; PowerShell scipt: 'test_3.ps1'
; Otput ROM: 'test_3.bin'

; ==========================================================

; Instruction set
    .PC02                                                   ; 65C02

; Parameters
    .INCLUDE        "../lib/par/var_hw.asm"                 ; Hardware parameters
    .INCLUDE        "../lib/par/char_map.asm"               ; Characters map

; Macros
    .INCLUDE        "../lib/mcr/cpu.asm"                    ; CPU functions
    .INCLUDE        "../lib/mcr/lcd.asm"                    ; LCD
    .INCLUDE        "../lib/mcr/via.asm"                    ; VIA
    .INCLUDE        "../lib/mcr/utils.asm"                  ; Utilities
    .INCLUDE        "../lib/mcr/math_arithm.asm"            ; Arithmetic

; ==========================================================

; RAM adresses
    COUNTER         = $0200                                 ; Counter (2 B)
    TMP_1           = $0202                                 ; Temporary quotient (2 B)
    TMP_2           = $0204                                 ; Temporary remainder (2 B)
    COUNTER_STR     = $0206                                 ; Counter string (6 B)

; ==========================================================

; Vectors
    .SEGMENT        "RESET"
    .WORD           ROM_A
    .SEGMENT        "INTERRUPT"
    .WORD           INTERRUPT
    .SEGMENT        "INTERRUPT_NM"
    .WORD           INTERRUPT_NM

; ==========================================================

; Main code
    .CODE

; Initialize hardware
START:
    CPU_INIT                                                ; CPU
    LCD_INIT                                                ; LCD
    VIA_INIT                                                ; VIA

; Initialize counter
    LDA             #0                                      ; Initialize counter
    STA             COUNTER
    STA             COUNTER + 1
    LDA             #CHAR_NULL                              ; Initialize counter string
    STA             COUNTER_STR
    BASE10_16       COUNTER, COUNTER_STR, TMP_1, TMP_2      ; Convert to base 10
    LCD_PRINT       LABEL_STR                               ; Display string
    LCD_PRINT       COUNTER_STR                             ; Display counter

; Idle
    JSR             IDLE_LOOP

; ==========================================================

; Interrupt
INTERRUPT:

; Store registers
    PHA
    TXA
    PHA
    TYA
    PHA

; Increment counter
    INC             COUNTER                                 ; Increment counter (low byte)
    BNE             EXIT_COUNTER                            ; If the low byte is not filled, exit
    INC             COUNTER + 1                             ; Increment counter (high byte)
EXIT_COUNTER:
    BASE10_16       COUNTER, COUNTER_STR, TMP_1, TMP_2      ; Convert to base 10

; Display counter
    JSR             LCD_HOME                                ; Set cursor home
    JSR             LCD_CLEAR                               ; Clear display
    LCD_PRINT       LABEL_STR                               ; Display string
    LCD_PRINT       COUNTER_STR                             ; Display counter

; Avoid bouncing
    LDY             #200                                    ; Delay 200 ms
    JSR             DELAY_MSS

; Restore registers
    PLA
    TAY
    PLA
    TAX
    PLA

; Clear interrupt
    BIT             VIA_RA                                  ; Clear interrupt
    RTI

; ==========================================================

; Non-maskable interrupt
INTERRUPT_NM:
    RTI

; ==========================================================

; Subroutines
    .INCLUDE        "../lib/sub/lcd.asm"                    ; LCD
    .INCLUDE        "../lib/sub/utils.asm"                  ; Utilities

; ==========================================================

; Data
    .DATA

; Counter label
LABEL_STR:
    .BYTE           CHAR_C_UP
    .BYTE           CHAR_O
    .BYTE           CHAR_U
    .BYTE           CHAR_N
    .BYTE           CHAR_T
    .BYTE           CHAR_E
    .BYTE           CHAR_R
    .BYTE           CHAR_COLON
    .BYTE           CHAR_SPACE
    .BYTE           CHAR_NULL
