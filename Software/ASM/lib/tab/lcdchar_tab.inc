; Character table for the LCD-016M002B screen of the ITER-8.

; ======================================================================================================================

; Numbers
    char_0          = %00110000                                       ; "0"
    char_1          = %00110001                                       ; "1"
    char_2          = %00110010                                       ; "2"
    char_3          = %00110011                                       ; "3"
    char_4          = %00110100                                       ; "4"
    char_5          = %00110101                                       ; "5"
    char_6          = %00110110                                       ; "6"
    char_7          = %00110111                                       ; "7"
    char_8          = %00111000                                       ; "8"
    char_9          = %00111001                                       ; "9"

; ======================================================================================================================

; Upper case letters
    char_a_up       = %01000001                                       ; "A"
    char_b_up       = %01000010                                       ; "B"
    char_c_up       = %01000011                                       ; "C"
    char_d_up       = %01000100                                       ; "D"
    char_e_up       = %01000101                                       ; "E"
    char_f_up       = %01000110                                       ; "F"
    char_g_up       = %01000111                                       ; "G"
    char_h_up       = %01001000                                       ; "H"
    char_i_up       = %01001001                                       ; "I"
    char_j_up       = %01001010                                       ; "J"
    char_k_up       = %01001011                                       ; "K"
    char_l_up       = %01001100                                       ; "L"
    char_m_up       = %01001101                                       ; "M"
    char_n_up       = %01001110                                       ; "N"
    char_o_up       = %01001111                                       ; "O"
    char_p_up       = %01010000                                       ; "P"
    char_q_up       = %01010001                                       ; "Q"
    char_r_up       = %01010010                                       ; "R"
    char_s_up       = %01010011                                       ; "S"
    char_t_up       = %01010100                                       ; "T"
    char_u_up       = %01010101                                       ; "U"
    char_v_up       = %01010110                                       ; "V"
    char_w_up       = %01010111                                       ; "W"
    char_y_up       = %01011001                                       ; "Y"
    char_z_up       = %01011010                                       ; "Z"

; ======================================================================================================================

; Lower case letters
    char_a          = %01100001                                       ; "a"
    char_b          = %01100010                                       ; "b"
    char_c          = %01100011                                       ; "c"
    char_d          = %01100100                                       ; "d"
    char_e          = %01100101                                       ; "e"
    char_f          = %01100110                                       ; "f"
    char_g          = %01100111                                       ; "g"
    char_h          = %01101000                                       ; "h"
    char_i          = %01101001                                       ; "i"
    char_j          = %01101010                                       ; "j"
    char_k          = %01101011                                       ; "k"
    char_l          = %01101100                                       ; "l"
    char_m          = %01101101                                       ; "m"
    char_n          = %01101110                                       ; "n"
    char_o          = %01101111                                       ; "o"
    char_p          = %01110000                                       ; "p"
    char_q          = %01110001                                       ; "q"
    char_r          = %01110010                                       ; "r"
    char_s          = %01110011                                       ; "s"
    char_t          = %01110100                                       ; "t"
    char_u          = %01110101                                       ; "u"
    char_v          = %01110110                                       ; "v"
    char_w          = %01110111                                       ; "w"
    char_x          = %01111000                                       ; "x"
    char_y          = %01111001                                       ; "y"
    char_z          = %01111010                                       ; "z"

; ======================================================================================================================

; Greek letters
    char_alpha      = %11100000                                       ; Alpha
    char_beta       = %11100010                                       ; Beta
    char_epsilon    = %11100011                                       ; Epsilon
    char_theta      = %11110010                                       ; Theta
    char_mu         = %11100100                                       ; Mu
    char_pi         = %11110111                                       ; Pi
    char_rho        = %11100110                                       ; Rho
    char_sigma      = %11100101                                       ; Sigma
    char_sigma_up   = %11110110                                       ; Sigma upper case
    char_omega_up   = %11110100                                       ; Omega upper case

; ======================================================================================================================

; Punctuation
    char_space      = %00100000                                       ; " "
    char_comma      = %00101100                                       ; ","
    char_stop       = %00101110                                       ; "."
    char_colon      = %00111010                                       ; ":"
    char_semicolon  = %00111011                                       ; ";"
    char_question   = %00111111                                       ; "?"
    char_exclam     = %00100001                                       ; "!"
    char_ampersand  = %00100110                                       ; "&"
    char_quote      = %00100010                                       ; """
    char_apostrophe = %00100111                                       ; "'"
    char_backtick   = %01100000                                       ; "`"
    char_dash       = %00101101                                       ; "-"
    char_slash      = %00101111                                       ; "/"
    char_bar        = %01111100                                       ; "|"
    char_parenth_l  = %00101000                                       ; "("
    char_parenth_r  = %00101001                                       ; ")"
    char_bracket_l  = %01011011                                       ; "["
    char_bracket_r  = %01011101                                       ; "]"
    char_curly_l    = %01111011                                       ; "{"
    char_curly_r    = %01111101                                       ; "}"

; ======================================================================================================================

; Symbols
    char_chevron_l  = %00111100                                       ; "<"
    char_chevron_r  = %00111110                                       ; ">"
    char_equal      = %00111101                                       ; "="
    char_plus       = %00101011                                       ; "+"
    char_star       = %00101010                                       ; "*"
    char_division   = %11111101                                       ; Division
    char_percent    = %00100101                                       ; "%"
    char_sqrt       = %11101000                                       ; Square root
    char_infinite   = %11110011                                       ; Infinite
    char_dot        = %10100101                                       ; Middle dot
    char_caret      = %01011110                                       ; "^"
    char_underscore = %01011111                                       ; "_"
    char_hash       = %00100011                                       ; "#"
    char_at         = %01000000                                       ; "@"
    char_dollar     = %00100100                                       ; "$"
    char_cent       = %11101100                                       ; Cent
    char_arrow_l    = %01111111                                       ; Left arrow
    char_arrow_r    = %01111110                                       ; Right arrow
    char_block      = %11111111                                       ; Block

; ======================================================================================================================

; Special
    char_null       = %00000000                                       ; NULL
